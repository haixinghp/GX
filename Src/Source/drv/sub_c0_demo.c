
#include "sub_c0_demo.h"
#include "c0_drv.h"
#include "cpm_drv.h"
#include "delay.h"
#include "debug.h"

//#define C0_REGISTER_TEST //M4直接操作C0的寄存器,C0不运行
//#define C0_LOWPOWER_TEST //M4 Load bin文件到C0 SRAM中运行, C0 lowpower
//#define C0_POFF1_TEST    //M4 Load bin文件到C0 SRAM中运行, C0 POFF1
#define C0_POFF2_TEST    //M4 Load bin文件到C0 SRAM中运行, C0 POFF2

#ifdef C0_LOWPOWER_TEST
const unsigned char lp_test_data[] = {
	0x20,0x01,0x00,0x00,0x76,0x09,0x00,0x00,0x84,0x09,0x00,0x00,0x68,0x09,0x00,0x00,
	0x92,0x09,0x00,0x00,0x68,0x09,0x00,0x00,0x68,0x09,0x00,0x00,0xa0,0x09,0x00,0x00,
	0xae,0x09,0x00,0x00,0x68,0x09,0x00,0x00,0x68,0x09,0x00,0x00,0x68,0x09,0x00,0x00,
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	0x00,0x98,0x08,0x12,0x80,0x12,0x00,0x88,0x30,0x20,0xcf,0x00,
};

const int lp_test_data_len = 2492;
#endif

#ifdef C0_POFF1_TEST
const unsigned char poff1_test_data[] = {
	0x00,0x01,0x00,0x00,0x8a,0x04,0x00,0x00,0x98,0x04,0x00,0x00,0x7c,0x04,0x00,0x00,
	0xa6,0x04,0x00,0x00,0x7c,0x04,0x00,0x00,0x7c,0x04,0x00,0x00,0xb4,0x04,0x00,0x00,
	0xc2,0x04,0x00,0x00,0x7c,0x04,0x00,0x00,0x7c,0x04,0x00,0x00,0x7c,0x04,0x00,0x00,
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	0xcf,0x00,0x30,0x24,0x00,0x98,0x08,0x12,0x80,0x12,0x00,0x88,0x30,0x20,0xcf,0x00
};
const int poff1_test_data_len = 1232;
#endif

#ifdef C0_POFF2_TEST
const unsigned char poff2_test_data[] = {
	0x00,0x01,0x00,0x00,0x8a,0x05,0x00,0x00,0x98,0x05,0x00,0x00,0x7c,0x05,0x00,0x00,
	0xa6,0x05,0x00,0x00,0x7c,0x05,0x00,0x00,0x7c,0x05,0x00,0x00,0xb4,0x05,0x00,0x00,
	0xc2,0x05,0x00,0x00,0x7c,0x05,0x00,0x00,0x7c,0x05,0x00,0x00,0x7c,0x05,0x00,0x00,
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	0xcf,0x00,0x30,0x24,0x00,0x98,0x08,0x12,0x80,0x12,0x00,0x88,0x30,0x20,0xcf,0x00,
};
const int poff2_test_data_len = 1488;
#endif

void Sub_C0_Demo(void)
{
	int i = 0;
	
	CPM->CPM_CHIPCFGR |= (1 << 19);   //enable sub system to main system output isolation
	CPM->CPM_SYSRSTCR = (1<<22);  //reset M2S_BUS
	delay(1500);    //delay MUST more than 10us.
	CPM->CPM_CHIPCFGR &=~ (1 << 19);    //disable sub system to main system output isolation
	CPM->CPM_SYSRSTCR = 0;    
	delay(1500);    //delay MUST more than 10us.

#ifdef C0_REGISTER_TEST
	C0_CPM->CPM_VCCQGTRIMR |= (1 << 30);  //ldo enter lowpower in normal mode, See VDD_SUB 0.9V 
	
  C0_WDT->WDT_WCR = 0x0; //Close C0 WDT
  C0_TC->TCCR = 0x0; //Close C0 TC

	C0_EPORT_ConfigGpio(EPORT_PIN8, GPIO_OUTPUT);
	while(1)
	{
	  //Flash LED(EPORT8)
	  C0_EPORT_WriteGpioData(EPORT_PIN8,Bit_SET);
	  delay(100000);
	  C0_EPORT_WriteGpioData(EPORT_PIN8,Bit_RESET);
	  delay(100000);
	}
#endif

#ifdef C0_LOWPOWER_TEST
	if(C0_CPM->CPM_SRSTMASKR & 0x80000000)
	{
		C0_load_bin_to_mem((UINT8 *)lp_test_data, lp_test_data_len);//EPOER7 wakeup, Flash LED(EPORT8)
		//C0_CPM->CPM_SRSTMASKR &= ~(0x80000000); //assert the reset of Core CS0.
		C0_CPM->CPM_PWRINDICR = (1<<7);
		C0_CPM->CPM_PWRINDICR |= (1<<15);	//assert the reset of Core CS0.
	}
#endif

#ifdef C0_POFF1_TEST
	if(C0_CPM->CPM_SRSTMASKR & 0x80000000)
	{
		C0_load_bin_to_mem((UINT8 *)poff1_test_data, poff1_test_data_len);//Flash LED(EPORT8)
		//C0_CPM->CPM_SRSTMASKR &= ~(0x80000000); //assert the reset of Core CS0.
		C0_CPM->CPM_PWRINDICR = (1<<7);
		C0_CPM->CPM_PWRINDICR |= (1<<15);	//assert the reset of Core CS0.
	}
#endif

#ifdef C0_POFF2_TEST
	if(C0_CPM->CPM_SRSTMASKR & 0x80000000)
	{
		C0_load_bin_to_mem((UINT8 *)poff2_test_data, poff2_test_data_len);//WK_SUB PAD wakeup, Flash LED(EPORT8)
		//C0_CPM->CPM_SRSTMASKR &= ~(0x80000000); //assert the reset of Core CS0.
		C0_CPM->CPM_PWRINDICR = (1<<7);
		C0_CPM->CPM_PWRINDICR |= (1<<15);	//assert the reset of Core CS0.
	}
#endif

	while(1)
	{
		//printf("M4 run./\n");
		i++;
		i--;
	}	
}
#define C0_SLPCR      *(volatile UINT32*) (C0_CPM_BASE_ADDR + 0x4)
void SubC0_Init(void)
{
	CPM->CPM_CHIPCFGR |= (1 << 19);   //enable sub system to main system output isolation
	CPM->CPM_SYSRSTCR = (1<<22);  //reset M2S_BUS
	delay(1500);    //delay MUST more than 10us.
	CPM->CPM_CHIPCFGR &=~ (1 << 19);    //disable sub system to main system output isolation
	CPM->CPM_SYSRSTCR = 0;    
	delay(1500);    //delay MUST more than 10us.
	C0_CPM->CPM_VCCQGTRIMR |= (1 << 30);  //ldo enter lowpower in normal mode, See VDD_SUB 0.9V 
	
  C0_WDT->WDT_WCR = 0x0; //Close C0 WDT
  C0_TC->TCCR = 0x0; //Close C0 TC
 *((volatile UINT32 *)(0x08146018)) = 0x00c0f000;
}
//void Sub_C0_into_poweroff2()
//{
//	if(C0_CPM->CPM_SRSTMASKR & 0x80000000)
//	{
//		printf("go to here\r\n");
//		C0_load_bin_to_mem((UINT8 *)poff2_test_data, poff2_test_data_len);//WK_SUB PAD wakeup, Flash LED(EPORT8)
//		//C0_CPM->CPM_SRSTMASKR &= ~(0x80000000); //assert the reset of Core CS0.
//		C0_CPM->CPM_PWRINDICR = (1<<7);
//		C0_CPM->CPM_PWRINDICR |= (1<<15);	//assert the reset of Core CS0.
//	}
////	delay(30000); //delay MUST more than 10us.

//// C0_SLPCR = 0x1;

//// delay(30); //delay MUST more than 10us.
//// 
//// CPM->CPM_CHIPCFGR |= (1 << 19);   //enable sub system to main system output isolation
//	
//	
//}

const unsigned int C0_into_poweroff2[] = {
	0x00000100,0x000002b6,0x000002c4,0x000002a8,
	0x000002d2,0x000002a8,0x000002a8,0x000002e0,
	0x000002ee,0x000002a8,0x000002a8,0x000002a8,
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	0x12089800,0x88001280,0x00cf2030,
};
const unsigned int C0_into_poweroff2_total_words = 191;

void Sub_C0_into_poweroff2()
{
		int i = 0;
	
	CPM->CPM_CHIPCFGR |= (1 << 19);   //enable sub system to main system output isolation
	CPM->CPM_SYSRSTCR = (1<<22);  		//reset M2S_BUS
	delay(1500);											//delay MUST more than 10us.	
	CPM->CPM_CHIPCFGR &=~ (1 << 19);	//disable sub system to main system output isolation
	CPM->CPM_SYSRSTCR = 0;
	delay(1500);					//delay MUST more than 10us.	

#ifdef C0_REGISTER_TEST
	C0_CPM->CPM_VCCQGTRIMR |= (1 << 30);  //ldo enter lowpower in normal mode, See VDD_SUB 0.9V 
	
  C0_WDT->WDT_WCR = 0x0; //Close C0 WDT
  C0_TC->TCCR = 0x0; //Close C0 TC
#endif

//#ifdef C0_POFF2_TEST
  C0_load_bin_to_mem((UINT8 *)C0_into_poweroff2, C0_into_poweroff2_total_words*4);//WK_SUB PAD wakeup, Flash LED(EPORT8)
	C0_CPM->CPM_SRSTMASKR &= ~(0x80000000); //assert the reset of Core CS0.
//#endif

	delay(30000);	//delay MUST more than 10us.

	C0_SLPCR = 0x1;

	delay(30);	//delay MUST more than 10us.
	
	CPM->CPM_CHIPCFGR |= (1 << 19);   //enable sub system to main system output isolation
}
