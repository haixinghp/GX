/***************************************************************************************
**文件名:     DRV_IR.c
**版本:       V1.00
**说明:       此文件可以根据实际情况修改。
**修改记录:   
*版本:V1.00     
*修改者:hhx    
*时间:
*修改说明：                    
创建了这个文件
**备注:      
****************************************************************************************/
#include "DRV_IR.h"
#if  DRV_IR_MODULE_EN
#warning DRV_IR模块使能!
/*******************************宏定义***************************/  
/*************************.C变量结构声明***********************/  

/*************************私有全局变量*************************/  
static UART_TypeDef *irUart = DRV_IR_UART;
/*************************公共全局变量*************************/  

/*************************局部函数*****************************/  


/*************************全局函数****************************/  
/***************************************************************************************
**函数名:       DRV_IR_IoInit
**功能描述:     IO初始化
**输入参数:     --
**输出参数:     --
**备注:         
****************************************************************************************/
void DRV_IR_IOInit(void)
{
	M_IR_IRQ_IN_NOPULL(); //中断配置为浮空输入
	M_IR_IRQ_EXIT_INT_DISABLE(); //关闭中断
}
/***************************************************************************************
**函数名:       DRV_IR_Init
**功能描述:     初始化
**输入参数:     --
**输出参数:     --
**备注:         
****************************************************************************************/
void DRV_IR_Init(void)
{
	M_4052_EN_OUT_PP();
	M_4052_A0_OUT_PP();
	M_4052_A1_OUT_PP();
	M_4052_EN_OUT_0();
	M_4052_A0_OUT_0();
	M_4052_A1_OUT_0(); //使能Y0
	DRV_IR_IOInit();
    UART_InitTypeDef UART_InitStruct;
	UART_InitStruct.UART_BaudRate = 9600;
	UART_InitStruct.UART_FrameLength = UART_DATA_FRAME_LEN_10BIT;
	UART_InitStruct.UART_Mode = UART_INT_MODE; //采用CPU中断方式
	UART_InitStruct.UART_Parity = UART_PARITY_NONE;
	UART_InitStruct.UART_TimeoutCounter = 0x40;
	UART_Init(irUart, &UART_InitStruct);
}
/***************************************************************************************
**函数名:       DRV_IR_UartColse
**功能描述:     串口模式关闭
**输入参数:     --
**输出参数:     --
**备注:         
****************************************************************************************/
void DRV_IR_UartColse(void)
{
	M_4052_EN_OUT_PP();
	M_4052_A0_OUT_PP();
	M_4052_A1_OUT_PP();
	M_4052_EN_OUT_0();
	M_4052_A0_OUT_1();
	M_4052_A1_OUT_0(); //使能Y1
}
/***************************************************************************************
**函数名:       DRV_IR_RecvDataUnblock
**功能描述:     非阻塞式接收数据
**输入参数:     
TYPEs_IRTrans *p, 接收控制
uint32_t RxMaxTime  一帧接收完成时间
**输出参数:     
int8_t
1; //接收完成
0; //数据接收中
-1; //参数错误
-2; //没有数据
-3; //接收参数错误
-4; //未开始接收
**备注:         
****************************************************************************************/
int8_t DRV_IR_RecvDataUnblock(TYPEs_IRTrans *p,uint32_t RxMaxTime)
{
    uint8_t receTmp; //获取数据的临时变量
    do
    {
        if (0 == UART_RecvByte(irUart, &receTmp))
        {
            p->rxBuf[p->rxCnt] = receTmp; //把缓冲区所有的数据读完
            p->rxCnt++;
            if (p->rxCnt >= (sizeof(p->rxBuf))) //超过了最大的处理空间
            {
                DEBUG_LOG_OUT("DRV_BleComm_RecvDataUnblock p->rxCnt >= DRV_COMM_RX_BUF_SIZE\n");
                return 1; //接收完成,先处理
            }
            p->rxTim = 1;
        }
        else
        {
            if (0 != p->rxTim)
            {
                p->rxTim++;
                if (p->rxTim >= RxMaxTime) //一帧接收完成
                {
                    if (0 == p->rxCnt) //查询数据长度
                    {
                        p->rxTim = 0; //清除超时，继续接收
                        return -2;             //没有数据
                    }
                    else
                    {
                        DEBUG_LOG_OUT("DRV_BleComm_RecvDataUnblock OK\n");
                        p->rxTim = 0; //清除超时，继续接收
                        return 1;              //接收完成
                    }
                }
                else
                {
                    return 0; //数据接收中
                }
            }
            else
            {
                return -4; //未开始接收
            }
        }
    } while (1);
}
/***************************************************************************************
**函数名:       DRV_IR_SendData
**功能描述:     发送数据
**输入参数:     --
**输出参数:     --
**备注:         
****************************************************************************************/
void DRV_IR_SendData(uint8_t *sendBuf, uint32_t len)
{
    UART_SendData(irUart, sendBuf, len);
}
/***************************************************************************************
**函数名:       DRV_BleComm_ClearRxPar
**功能描述:     清除接收
**输入参数:     --
**输出参数:     
int8_t
-1; //参数错误
0; //成功
**备注:         
****************************************************************************************/
int8_t  DRV_IR_ClearRxPar(TYPEs_IRTrans *p)
{
    memset(p->rxBuf, 0, sizeof(p->rxBuf));
    p->rxCnt = 0;
    p->rxTim = 0;
    return 0;
}

/***************************************************************************************
**函数名:       DRV_IR_ReadIRQ
**功能描述:     读取IO
**输入参数:     --
**输出参数:     
uint8_t
**备注:         
****************************************************************************************/
uint8_t DRV_IR_ReadIRQ(void)
{
    return M_IR_IRQ_READIN();
}

#endif  /*DRV_IR_MODULE_EN*/
/************************************Code End******************************************/